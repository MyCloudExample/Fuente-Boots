/dts-v1/;
/plugin/;

/ {
    compatible = "brcm,bcm2835";

    fragment@0 {
        target = <&uart0>;
        __overlay__ {
            status = "okay";

            egb_device {
                compatible = "frankie,egb-uart";
                status = "okay";
            };
        };
    };
};
